/*	Arduino Nano Electric Ouija Board by LSSteele and GitHub CoPilot 02/16/2026
	Modified: Planchette moves based on capacitance/resistance electrical impulses.

  Compiles and Works!
  
  IMPROVED VERSION - Enhanced sensitivity and movement
*/

#include <Wire.h>
#include <Adafruit_GFX.h>
#include <Adafruit_SSD1306.h>

#define SCREEN_WIDTH 128
#define SCREEN_HEIGHT 64
#define OLED_RESET -1
Adafruit_SSD1306 display(SCREEN_WIDTH, SCREEN_HEIGHT, &Wire, OLED_RESET);

// Bitmap dimensions
#define OUIJA_WIDTH 128
#define OUIJA_HEIGHT 64

// Bitmap dimensions
#define OUIJA_WIDTH 128
#define OUIJA_HEIGHT 64
// 'Ouija 128x64', 128x64px
const unsigned char epd_bitmap_Ouija_128x64 [] PROGMEM = {
	0xff, 0xff, 0xff, 0xff, 0xff, 0xff, 0xff, 0xff, 0xff, 0xff, 0xff, 0xff, 0xff, 0xff, 0xff, 0xff, 
	0xff, 0xff, 0xff, 0xff, 0xff, 0xff, 0xff, 0xff, 0xff, 0xff, 0xff, 0xff, 0xff, 0xff, 0xff, 0xff, 
	0xff, 0xff, 0xff, 0xff, 0xff, 0xff, 0xff, 0xff, 0xff, 0xff, 0xff, 0xff, 0xff, 0xff, 0xff, 0xff, 
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	0xff, 0xff, 0xff, 0xff, 0xff, 0xff, 0xff, 0xff, 0xff, 0xff, 0xff, 0xff, 0xff, 0xff, 0xff, 0xff
};

// Array of all bitmaps for convenience. (Total bytes used to store images in PROGMEM = 1040)
const int epd_bitmap_allArray_LEN = 1;
const unsigned char* epd_bitmap_allArray[1] = {
	epd_bitmap_Ouija_128x64
};

const int touchPins[4] = {A0, A1, A2, A3}; // 4 membrane switches
const int NUM_SENSORS = 4;
const int threshold = 5; // Lowered threshold for more sensitivity

int prevVals[NUM_SENSORS] = {0, 0, 0, 0}; // To store previous readings

int planchetteX = SCREEN_WIDTH / 2;
int planchetteY = SCREEN_HEIGHT / 2;

const int bitmapX = (SCREEN_WIDTH - OUIJA_WIDTH) / 2;
const int bitmapY = 0;

// Movement parameters - adjust these for different behavior
const int movementDivisor = 2; // Lower = more movement (was 4, now 2)
const int minMovement = 1;      // Minimum pixels to move when threshold exceeded

void setup() {
  Serial.begin(9600); // For debugging
  
  display.begin(SSD1306_SWITCHCAPVCC, 0x3C);
  display.clearDisplay();
  
  // Initialize previous values
  for (int i = 0; i < NUM_SENSORS; i++) {
    prevVals[i] = analogRead(touchPins[i]);
  }
  
  randomSeed(analogRead(A5)); // Use an unused analog pin for better randomness
  
  Serial.println("Electric Ouija Board Initialized");
  Serial.println("Touch sensors on A0-A3");
}

void loop() {
  int currVals[NUM_SENSORS];
  int deltas[NUM_SENSORS];

  // Read the current values
  for (int i = 0; i < NUM_SENSORS; i++) {
    currVals[i] = analogRead(touchPins[i]);
    // Calculate the change (delta)
    deltas[i] = abs(currVals[i] - prevVals[i]);
    prevVals[i] = currVals[i];
  }

  // Calculate total change across all sensors
  int totalDelta = 0;
  for (int i = 0; i < NUM_SENSORS; i++) {
    totalDelta += deltas[i];
  }

  // Ignore changes if they are below the threshold
  if (totalDelta > threshold) {
    // Debug output
    Serial.print("Deltas: ");
    for (int i = 0; i < NUM_SENSORS; i++) {
      Serial.print(deltas[i]);
      Serial.print(" ");
    }
    Serial.print("| Total: ");
    Serial.print(totalDelta);
    
    // Introduce randomness weighted by the deltas
    // Divide by 2 instead of 4 for more movement
    int dx = random(-max(deltas[0] / movementDivisor, minMovement), 
                     max(deltas[1] / movementDivisor, minMovement) + 1);
    int dy = random(-max(deltas[2] / movementDivisor, minMovement), 
                     max(deltas[3] / movementDivisor, minMovement) + 1);

    Serial.print(" | dx: ");
    Serial.print(dx);
    Serial.print(" dy: ");
    Serial.println(dy);

    planchetteX += dx;
    planchetteY += dy;

    // Stay within bounds
    planchetteX = constrain(planchetteX, bitmapX, bitmapX + OUIJA_WIDTH - 1);
    planchetteY = constrain(planchetteY, bitmapY, bitmapY + OUIJA_HEIGHT - 1);
  }

  // Draw the Ouija board
  display.clearDisplay();
  display.drawBitmap(bitmapX, bitmapY, epd_bitmap_Ouija_128x64, OUIJA_WIDTH, OUIJA_HEIGHT, SSD1306_WHITE);

  // Draw the planchette as a transparent ring
  const int planchetteRadius = 8;
  display.drawCircle(planchetteX, planchetteY, planchetteRadius, SSD1306_WHITE);   // Outer circle
  display.drawCircle(planchetteX, planchetteY, planchetteRadius - 2, SSD1306_BLACK); // Inner circle (erases center)

  display.display();
  delay(40); // Smooth animation
}